## drivers/net/wireless/rtl8192cu/Kconfig
```kconfig
config RTL8192CU
	tristate "Realtek 8192C USB WiFi"
        select WIRELESS_EXT
        select CRYPTO
        select WEXT_SPY
        select WEXT_PRIV
	depends on USB
	---help---
	  Help message of RTL8192CU
```
